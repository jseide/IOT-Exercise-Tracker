## CMakeLists.txt
```
# SPDX-License-Identifier: Apache-2.0

cmake_minimum_required(VERSION 3.13.1)

#Copies compile_commands.json to root dir
set( CMAKE_EXPORT_COMPILE_COMMANDS ON )
add_custom_target(
    copy-compile-commands ALL
    ${CMAKE_COMMAND} -E copy_if_different
        ${CMAKE_BINARY_DIR}/compile_commands.json
        ${CMAKE_CURRENT_LIST_DIR}
    )

find_package(Zephyr REQUIRED HINTS $ENV{ZEPHYR_BASE})
project(detect)

# These samples use local static initialization. Since Zephyr doesn't support the
# C++ ABI for thread-safe initialization of local statics and the constructors don't
# appear to require thread safety, we turn it off in the C++ compiler.
set(NO_THREADSAFE_STATICS $<TARGET_PROPERTY:compiler-cpp,no_threadsafe_statics>)
zephyr_compile_options($<$<COMPILE_LANGUAGE:CXX>:${NO_THREADSAFE_STATICS}>)

file(GLOB app_sources src/* src/tflite/*)
target_sources(app PRIVATE ${app_sources})
```

## prj.conf
```kconfig
CONFIG_SNTP=y
CONFIG_I2C=y
CONFIG_MINIMAL_LIBC_RAND=y
CONFIG_CBPRINTF_FP_SUPPORT=y
CONFIG_TIMING_FUNCTIONS=y
CONFIG_CPLUSPLUS=y
CONFIG_LIB_CPLUSPLUS=y
CONFIG_NEWLIB_LIBC=y
CONFIG_NEWLIB_LIBC_FLOAT_PRINTF=y
CONFIG_SENSOR=y
CONFIG_MAIN_STACK_SIZE=8000
CONFIG_TENSORFLOW_LITE_MICRO=y
CONFIG_DK_LIBRARY=y
CONFIG_COAP=y
CONFIG_LOG=y
CONFIG_LOG_DEFAULT_LEVEL=4
CONFIG_SYSTEM_WORKQUEUE_STACK_SIZE=8000

CONFIG_NETWORKING=y
CONFIG_NET_IPV4=n
CONFIG_NET_IPV6=y
CONFIG_NET_UDP=y
CONFIG_NET_L2_OPENTHREAD=y
CONFIG_NET_SOCKETS=y
CONFIG_NET_SOCKETS_POLL_MAX=4

#INPUT YOUR OPENTHREAD NETWORK CREDENTIALS BELOW
CONFIG_OPENTHREAD_NETWORKKEY="00:11:22:33:44:55:66:77:88:99:aa:bb:cc:dd:ee:ff"
CONFIG_OPENTHREAD_XPANID="de:ad:00:be:ef:00:ca:fe"
CONFIG_OPENTHREAD_PANID=45482
CONFIG_OPENTHREAD_CHANNEL=14

CONFIG_OPENTHREAD_NORDIC_LIBRARY_MASTER=y
CONFIG_OPENTHREAD_THREAD_VERSION_1_2=y
CONFIG_MBEDTLS_TLS_LIBRARY=y

CONFIG_NET_SOCKETS_SOCKOPT_TLS=y
CONFIG_NET_SOCKETS_ENABLE_DTLS=y
CONFIG_MBEDTLS_KEY_EXCHANGE_PSK_ENABLED=y
CONFIG_NET_SOCKETS_TLS_SET_MAX_FRAGMENT_LENGTH=n

# Network address config
CONFIG_NET_CONFIG_SETTINGS=y
CONFIG_NET_CONFIG_NEED_IPV4=n
CONFIG_NET_CONFIG_NEED_IPV6=y

CONFIG_NET_SOCKETS_POSIX_NAMES=n
CONFIG_POSIX_API=y

# Enable MTD Sleepy End Device
CONFIG_OPENTHREAD_MTD=y
CONFIG_OPENTHREAD_MTD_SED=y
CONFIG_OPENTHREAD_POLL_PERIOD=3000
CONFIG_RAM_POWER_DOWN_LIBRARY=y
CONFIG_PM_DEVICE=y
```

## src/main.c
```c
#include <zephyr/kernel.h>
#include <zephyr/logging/log.h>
#include <ram_pwrdn.h>
#include <zephyr/device.h>
#include <zephyr/pm/device.h>
#include <dk_buttons_and_leds.h>
#include <zephyr/devicetree.h>
#include <zephyr/drivers/i2c.h>
#include <ram_pwrdn.h>
#include <stdlib.h>
#include <zephyr/timing/timing.h>
#include <sys/time.h>
#include <arpa/inet.h>
#include <zephyr/net/sntp.h>

#include "tflite/main_functions.h"
#include "coap_client_utils.h"


LOG_MODULE_REGISTER(DETECT, 4);

#define SLEEP_TIME_MS   1000

#if DATA_COLLECTION
enum {negative, curl, press} exercise = negative;
#define DETECT_LED DK_LED1
#define NEGATIVE_LED DK_LED2
#define CURL_LED DK_LED3
#define PRESS_LED DK_LED4
#else
#define DETECT_LED DK_LED1
#define OT_CONNECTION_LED DK_LED2
#define MTD_SED_LED DK_LED3
uint8_t num_reps;
#endif

static uint8_t addr = 0x28;
static uint8_t quat_val = 0x20;
static uint8_t imu_val = 0x08; 

static void repeating_timer_callback(struct k_timer *timer_id);
static void my_work_handler(struct k_work *work);

//static const struct device *dev_i2c;
const struct device *const dev_i2c = DEVICE_DT_GET(DT_NODELABEL(i2c0));

K_TIMER_DEFINE(my_timer, repeating_timer_callback, NULL);
K_WORK_DEFINE(my_work, my_work_handler);

float coap_buffer[COAP_BUFF_METADATA_SIZE+(NUM_DIMS*COAP_BUFF_TIMESTEPS)];
float detection_buffer[NUM_DIMS*DETECT_BUFF_TIMESTEPS];
uint32_t set_id;
int max_transmissions;
int transmit_timestep;
uint32_t *setid = (uint32_t *)coap_buffer;
uint16_t *metadata = (uint16_t *)coap_buffer;


static void my_work_handler(struct k_work *work){

#if TIMEIT
    timing_t start_time, end_time;
    uint64_t total_cycles;
    uint64_t total_ns;
    timing_init();
    timing_start();
    start_time = timing_counter_get();
#endif

    uint8_t quat[8]; 
    int16_t quatW, quatX, quatY, quatZ; 
    float quat_scale = (1.0 / (16384));

    uint8_t imu[18]; 
    int16_t accelX, accelY, accelZ; 
    float accel_scale = (1.0/100);
    int16_t magX, magY, magZ; 
    float mag_scale = (1.0/16);
    int16_t gyroX, gyroY, gyroZ; 
    float gyro_scale = (1.0/16);

    uint8_t dim_idx = NUM_DIMS*DETECT_BUFF_TIMESTEPS-NUM_DIMS;

    i2c_write_read(dev_i2c, addr, &quat_val, 1, quat, 8);
    quatW = ((quat[1]<<8) | quat[0]);
    quatX = ((quat[3]<<8) | quat[2]);
    quatY = ((quat[5]<<8) | quat[4]);
    quatZ = ((quat[7]<<8) | quat[6]);

    i2c_write_read(dev_i2c, addr, &imu_val, 1, imu, 18);
    accelX = ((imu[1]<<8) | imu[0]);
    accelY = ((imu[3]<<8) | imu[2]);
    accelZ = ((imu[5]<<8) | imu[4]);
    magX = ((imu[7]<<8) | imu[6]);
    magY = ((imu[9]<<8) | imu[8]);
    magZ = ((imu[11]<<8) | imu[10]);
    gyroX = ((imu[13]<<8) | imu[12]);
    gyroY = ((imu[15]<<8) | imu[14]);
    gyroZ = ((imu[17]<<8) | imu[16]);

    memmove(detection_buffer, &detection_buffer[NUM_DIMS], 
            ((DETECT_BUFF_TIMESTEPS-1)*NUM_DIMS)*sizeof(float));

    detection_buffer[dim_idx++] = quatW*quat_scale;
    detection_buffer[dim_idx++] = quatX*quat_scale;
    detection_buffer[dim_idx++] = quatY*quat_scale;
    detection_buffer[dim_idx++] = quatZ*quat_scale;
    detection_buffer[dim_idx++] = accelX*accel_scale;
    detection_buffer[dim_idx++] = accelY*accel_scale;
    detection_buffer[dim_idx++] = accelZ*accel_scale;
    detection_buffer[dim_idx++] = magX*mag_scale;
    detection_buffer[dim_idx++] = magY*mag_scale; 
    detection_buffer[dim_idx++] = magZ*mag_scale;
    detection_buffer[dim_idx++] = gyroX*gyro_scale;
    detection_buffer[dim_idx++] = gyroY*gyro_scale;
    detection_buffer[dim_idx++] = gyroZ*gyro_scale;

    loop(detection_buffer, NUM_DIMS*DETECT_BUFF_TIMESTEPS);

#if DATA_COLLECTION
    if (output>THRESHOLD){
        dk_set_led_on(DETECT_LED);
    }
    else {
        dk_set_led_off(DETECT_LED);
    }

    transmit_timestep++;
    if (!(transmit_timestep%COAP_BUFF_TIMESTEPS)){
        memcpy(&coap_buffer[COAP_BUFF_METADATA_SIZE],detection_buffer,
                NUM_DIMS*COAP_BUFF_TIMESTEPS*sizeof(float)); 
        metadata[4]=transmit_timestep - COAP_BUFF_TIMESTEPS;
        coap_publish_new();
        LOG_INF("Transmitting timestep: %d", transmit_timestep-COAP_BUFF_TIMESTEPS);
    }
#else
    if (output>=THRESHOLD){
        if (!max_transmissions){
            dk_set_led_on(DETECT_LED);
            setid[0] = (unsigned int) rand();
            setid[1] = time(NULL);
            metadata[5]=0;
            metadata[6]=num_reps;
            LOG_INF("NEW ID: %d",setid[0]);
            LOG_INF("Rep Label: %d",num_reps);
            transmit_timestep = 0;
        }
        max_transmissions = DETECT_BUFF_TIMESTEPS + DETECTION_PADDING + transmit_timestep + 
            (COAP_BUFF_TIMESTEPS - transmit_timestep%COAP_BUFF_TIMESTEPS);
    }

    if (transmit_timestep<=(max_transmissions)){
        transmit_timestep++;
        if (!(transmit_timestep%COAP_BUFF_TIMESTEPS)){
            memcpy(&coap_buffer[COAP_BUFF_METADATA_SIZE],detection_buffer,
                    NUM_DIMS*COAP_BUFF_TIMESTEPS*sizeof(float)); 
            metadata[4]=transmit_timestep - COAP_BUFF_TIMESTEPS;

            if (transmit_timestep==(max_transmissions)){
                //LOG_INF("Last One"); 
                dk_set_led_off(DETECT_LED);
                metadata[5]=1;
                max_transmissions=0;
            }
            coap_publish_new();
            //LOG_INF("Transmitting timestep: %d", transmit_timestep-COAP_BUFF_TIMESTEPS);
            //LOG_INF("Transmitting max_transmissions: %d", max_transmissions);
        }
    }
#endif 

#if TIMEIT
    end_time = timing_counter_get();
    total_cycles = timing_cycles_get(&start_time, &end_time);
    total_ns = timing_cycles_to_ns(total_cycles);
    timing_stop();
    LOG_INF("TIME: %llu",total_ns);
#endif
}

static void repeating_timer_callback(struct k_timer *timer_id) {

    k_work_submit(&my_work);
}

static void setup_imu(void){


    if (!device_is_ready(dev_i2c)) {
		printk("I2C: Device is not ready.\n");
		return;
	}

    LOG_INF("Setup IMU");
    k_msleep(SLEEP_TIME_MS);

    int ret;
    uint8_t reg = 0x00;
    uint8_t chipID[1];

    ret = i2c_write(dev_i2c, &reg, 1, addr);
    if(ret != 0){
        LOG_INF("Failed to write to I2C device address during write.");
        return;
    }

    ret = i2c_read(dev_i2c, chipID,1,addr);
    if(ret != 0){
        LOG_INF("Failed to write/read I2C device address during write.");
        return;
    }

    if(chipID[0] != 0xA0){
        LOG_INF("Chip ID Not Correct - %x\n",chipID[0]);
        return;
    }
    else{
        LOG_INF("Success!");
    }

    //Unit Selection
    uint8_t data[2];
    data[0] = 0x3B;
    data[1] = 0b0000000;
    ret = i2c_write(dev_i2c, data, 2, addr);
    if(ret != 0){
        LOG_INF("Failed to write to I2C device address during write.");
        return;
    }

    //Set Opr Mode
    data[0] = 0x3D;
    data[1] = 0x0C;
    ret = i2c_write(dev_i2c, data, 2, addr);
    if(ret != 0){
        LOG_INF("Failed to write to I2C device address during write.");
        return;
    }
}

static void on_mtd_mode_toggle(uint32_t med)
{
#if IS_ENABLED(CONFIG_PM_DEVICE) //still need the logs for debugging 
const struct device *cons = DEVICE_DT_GET(DT_CHOSEN(zephyr_console));

if (med) {
pm_device_action_run(cons, PM_DEVICE_ACTION_RESUME);
} else {
pm_device_action_run(cons, PM_DEVICE_ACTION_SUSPEND);
}
#endif
    LOG_INF("MTD CB");
#if !(DATA_COLLECTION)
    dk_set_led(MTD_SED_LED, med);
#endif
}

static void on_connect(struct k_work *item)
{

    k_msleep(SLEEP_TIME_MS);
    LOG_INF("Sending SNTP");
    int err = set_clock_sntp();
    if (err<0){
        LOG_ERR("SNTP_FAILED");
    }

    LOG_INF("Setting rand seed");
    srand(time(NULL));

    LOG_INF("Opening socket");
    coap_open_socket();

    coap_publish_new(); //sending empty buffer because first send is slow

#if DATA_COLLECTION
    setid[0] = (unsigned int) rand();
    setid[1] = time(NULL);
    LOG_INF("INITIAL ID: %d",setid[0]);
    dk_set_led_on(NEGATIVE_LED);
#else
    dk_set_led_on(OT_CONNECTION_LED);
#endif

    k_msleep(SLEEP_TIME_MS);
    k_msleep(SLEEP_TIME_MS);
    k_msleep(SLEEP_TIME_MS);

    LOG_INF("Starting IMU timer");
    k_timer_start(&my_timer, K_MSEC(IMU_FREQ_MS), K_MSEC(IMU_FREQ_MS));
}

static void on_disconnect(struct k_work *item)
{
    LOG_INF("Disconnected: pausing IMU and closing socket");
    coap_close_socket();
    k_timer_stop(&my_timer);
#if !(DATA_COLLECTION)
    dk_set_led_off(OT_CONNECTION_LED);
#endif
}

static void on_button_changed(uint32_t button_state, uint32_t has_changed)
{
    uint32_t buttons = button_state & has_changed;
    if (buttons & DK_BTN1_MSK) {
#if DATA_COLLECTION
        dk_set_led_off(NEGATIVE_LED);
        dk_set_led_off(CURL_LED);
        dk_set_led_off(PRESS_LED);
        switch (exercise){
            case negative:
                exercise = curl;
                dk_set_led_on(CURL_LED);
                break;
            case curl:
                exercise = press;
                dk_set_led_on(PRESS_LED);
                break;
            case press:
                exercise = negative;
                dk_set_led_on(NEGATIVE_LED);
                break;
        }
        setid[0] = rand();
        transmit_timestep=0;
        LOG_INF("\nSession ID: %d", setid[0]);     
        LOG_INF("Exercise ID: %d",exercise);
        metadata[5]=exercise;
#else
        LOG_INF("Toggle MTD Button");
        coap_client_toggle_minimal_sleepy_end_device();
#endif
}

#if (!DATA_COLLECTION)
    if (buttons & DK_BTN2_MSK) {
        num_reps+=1;
        if (num_reps>15){
            num_reps=0;
        }
        LOG_INF("Rep Label: %d",num_reps);
    }
#endif
}

void main(void)
{
    int ret;

    LOG_INF("Start...");
#if DATA_COLLECTION
    LOG_INF("Data Collection Enabled");
#else
    LOG_INF("Detect Enabled");
#endif

    if (IS_ENABLED(CONFIG_RAM_POWER_DOWN_LIBRARY)) {
        power_down_unused_ram();
    }

    ret = dk_leds_init();
    if (ret) {
        LOG_ERR("Cannot init leds, (error: %d)", ret);
        return;
    }

    ret = dk_buttons_init(on_button_changed);
    if (ret) {
        LOG_ERR("Cannot init buttons (error: %d)", ret);
        return;
    }

    setup_imu();
    setup_tflite();

    k_msleep(SLEEP_TIME_MS);

    LOG_INF("COAP STARTING!");
    coap_client_utils_init(on_connect,on_disconnect,on_mtd_mode_toggle);
}
```

## src/coap_client_utils.c
```c
#include <zephyr/kernel.h>
#include <zephyr/logging/log.h>
#include <zephyr/net/openthread.h>
#include <openthread/coap.h>
#include <openthread/thread.h>
#include <mbedtls/sha256.h>
#include <mbedtls/base64.h>
#include <stdio.h>
#include <openthread/crypto.h>
#include <zephyr/net/coap.h>
#include <sys/socket.h>
#include <zephyr/net/tls_credentials.h>
#include <sys/time.h>
#include <zephyr/net/sntp.h>
#include <arpa/inet.h>

#include "coap_client_utils.h"
#include "tflite/main_functions.h"


LOG_MODULE_REGISTER(coap_client_utils, 4);


/**
 * SNTP server address.
 */
#define SNTP_SERVER_ADDRESS                   "64:ff9b::d8ef:230c"
#define SNTP_SERVER_PORT                      123
#define JWT_TIMEOUT                           10

/**
 * Google Cloud Platform CoAP server parameters.
 */
#define GCP_COAP_IOT_CORE_SERVER_PORT         5683
#define GCP_COAP_IOT_CORE_SERVER_SECURE_PORT  5684

/**
 * Google Cloud Platform project configuration.
 * Must be configured by the user.
 */
#define GCP_COAP_IOT_CORE_SERVER_ADDRESS      "64:ff9b::1234:5678"
#define GCP_COAP_IOT_CORE_PATH                "gcp"
#define GCP_COAP_IOT_CORE_PROJECT_ID          "project_id"
#define GCP_COAP_IOT_CORE_REGION              "us-central1"
#define GCP_COAP_IOT_CORE_PUBLISH             "publishEvent"
#define GCP_COAP_IOT_CORE_CONFIG              "config"

#if DATA_COLLECTION
#define GCP_COAP_IOT_CORE_REGISTRY_ID         "coap-demo"
#else
#define GCP_COAP_IOT_CORE_REGISTRY_ID         "coap-detect"
#endif


/**
 * CoAP transport configuration.
 * Must be configured by the user.
 */
#define GCP_COAP_SECURE_ENABLED               1
#define GCP_COAP_SECURE_PSK_SECRET            "some_secret"
#define GCP_COAP_SECURE_PSK_IDENTITY          "my_identity"

/**
 * Google Cloud Platform device configuration.
 * Must be configured by the user.
 */
#define GCP_COAP_IOT_CORE_DEVICE_ID          "some_device_id"
#define GCP_COAP_IOT_CORE_DEVICE_KEY                                   \
"-----BEGIN EC PRIVATE KEY-----\r\n"                                   \
">>>>>>>>>>>>>>>>>>>>>>>>>>>>>>>>>>>>>>>>>>>>>>>>>>>>>>>>>>>>>>>>\r\n" \
">>>>>>>>>>>>>>>>>>>>>>>>>>>>>>>>>>>>>>>>>>>>>>>>>>>>>>>>>>>>>>>>r\n" \
">>>>>>>>>>>>>>>>>>>>>>>>>>>>>>>>>==\r\n"                             \
"-----END EC PRIVATE KEY-----\r\n"


/**
 * The JSON representation of the header with ES256 algorithm.
 */
#define JWT_HEADER_TYPE_ES256 \
    "{\"alg\":\"ES256\",\"typ\":\"JWT\"}"

/**
 * The maximum size of the JWT signature.
 */
#define JWT_SIGNATURE_SIZE 64

/**
 * The size of key length for ES256.
 */
#define JWT_KEY_LENGTH_ES256 32

/**
 * The JWT delimeter used to separete header, claim and signature.
 *
 */
#define JWT_DELIMETER '.'


#define PSK_TAG 1
#define MAX_COAP_MSG_LEN 4000
#define COAP_VER 1
#define COAP_TOKEN_LEN 8
#define JWT_BUFFER_LENGTH 512
#define SLEEP_TIME_MS   1000

bool is_connected = false;
static int sock;
static sec_tag_t sec_tag_list[] = {PSK_TAG};
static const uint8_t psk[] = "some_secret";
static const uint8_t psk_id[] = "my_identity";

static struct k_work toggle_MTD_SED_work;
static struct k_work on_connect_work;
static struct k_work on_disconnect_work;


mtd_mode_toggle_cb_t on_mtd_mode_toggle;

int set_clock_sntp(void)
{
    struct sntp_ctx ctx;
    struct sockaddr_in6 addr6;
    struct sntp_time sntp_time;
    struct timespec tspec;
    int ret;

    memset(&addr6, 0, sizeof(addr6));
    addr6.sin6_family = AF_INET6;
    addr6.sin6_port = htons(SNTP_SERVER_PORT);
    inet_pton(AF_INET6, SNTP_SERVER_ADDRESS, &addr6.sin6_addr);

    ret = sntp_init(&ctx, (struct sockaddr *) &addr6,
            sizeof(struct sockaddr_in6));
    if (ret < 0) {
        LOG_ERR("Failed to init SNTP IPv6 ctx: %d", ret);
        goto end;
    }

    LOG_INF("Sending SNTP IPv6 request...");
    ret = sntp_query(&ctx, 6000, &sntp_time);
    if (ret < 0) {
        LOG_ERR("SNTP IPv6 request: %d", ret);
        goto end;
    }

    LOG_INF("Time : %llu", sntp_time.seconds);

    tspec.tv_sec = sntp_time.seconds;
    tspec.tv_nsec = ((uint64_t)sntp_time.fraction*(1000*1000*1000))>>32;

    ret = clock_settime(CLOCK_REALTIME, &tspec);
    if (ret < 0) {
        LOG_ERR("Setting clock failed: %d", ret);
        goto end;
    }

end:
    sntp_close(&ctx);
    return ret;
}


/***************************************************************************************************
 * @section JWT generation.
 **************************************************************************************************/

static otError base64_url_encode(uint8_t *p_output, uint16_t *p_output_len, const uint8_t *p_buff, uint16_t length)
{
    otError error = OT_ERROR_NONE;
    int     result;
    size_t  encoded_len = 0;

    result = mbedtls_base64_encode(p_output, *p_output_len, &encoded_len, p_buff, length);

    if (result != 0)
    {
        return OT_ERROR_NO_BUFS;
    }

    // JWT uses URI as defined in RFC4648, while mbedtls as is in RFC1421.
    for (uint32_t index = 0; index < encoded_len; index++)
    {
        if (p_output[index] == '+')
        {
            p_output[index] = '-';
        }
        else if (p_output[index] == '/')
        {
            p_output[index] = '_';
        }
        else if (p_output[index] == '=')
        {
            p_output[index] = 0;
            encoded_len  = index;
            break;
        }
    }

    *p_output_len = encoded_len;

    return error;
}

static otError jwt_create(uint8_t       * p_output,
        uint16_t      * p_output_len,
        const uint8_t * p_claims,
        uint16_t        claims_len,
        const uint8_t * p_private_key,
        uint16_t        private_key_len)
{
    otError                error = OT_ERROR_NONE;
    uint8_t                hash[32];
    uint8_t                signature[JWT_SIGNATURE_SIZE];
    uint16_t               signature_size    = JWT_SIGNATURE_SIZE;
    uint16_t               output_max_length = *p_output_len;
    uint16_t               length;

    // Encode JWT Header using Base64 URL.
    length = output_max_length;

    error = base64_url_encode(p_output, &length, (const uint8_t *)JWT_HEADER_TYPE_ES256,
            strlen(JWT_HEADER_TYPE_ES256));
    __ASSERT_NO_MSG(error == OT_ERROR_NONE);

    *p_output_len = length;

    // Append delimiter.
    p_output[*p_output_len] = JWT_DELIMETER;
    *p_output_len += 1;

    // Encode JWT Claim using Base64 URL.
    length = output_max_length - *p_output_len;

    error = base64_url_encode(p_output + *p_output_len, &length, p_claims, claims_len);
    __ASSERT_NO_MSG(error == OT_ERROR_NONE);

    *p_output_len += length;

    // Create SHA256 Hash from encoded JWT Header and JWT Claim.
    error = mbedtls_sha256(p_output, *p_output_len, hash, 0);
    __ASSERT_NO_MSG(error == 0);

    // Append delimiter.
    p_output[*p_output_len] = JWT_DELIMETER;
    *p_output_len += 1;

    // Create ECDSA Sign.
    error = otCryptoEcdsaSign(signature, &signature_size, hash, sizeof(hash), p_private_key, private_key_len);
    __ASSERT_NO_MSG(error == OT_ERROR_NONE);

    // Encode JWT Sign using Base64 URL.
    length = output_max_length - *p_output_len;

    error = base64_url_encode(p_output + *p_output_len, &length, signature, signature_size);
    __ASSERT_NO_MSG(error == OT_ERROR_NONE);

    *p_output_len += length;

    return error;
}

/***************************************************************************************************
 * @section CoAP messages.
 **************************************************************************************************/
static void coap_header_proxy_uri_append(struct coap_packet * p_message, const char * p_action)
{

    otError error = OT_ERROR_NONE;
    char    jwt[JWT_BUFFER_LENGTH];
    char    claims[JWT_BUFFER_LENGTH];

    memset(jwt, 0, sizeof(jwt));
    memset(claims, 0, sizeof(claims));

    unsigned int m_unix_time = (unsigned int) time(NULL);

    uint16_t offset = snprintf(jwt, sizeof(jwt), "%s/%s/%s/%s/%s?jwt=",
            GCP_COAP_IOT_CORE_PROJECT_ID, GCP_COAP_IOT_CORE_REGION,
            GCP_COAP_IOT_CORE_REGISTRY_ID, GCP_COAP_IOT_CORE_DEVICE_ID,
            p_action);

    uint16_t output_len = sizeof(jwt) - offset;


    uint64_t timeout = m_unix_time + JWT_TIMEOUT;

    snprintf(claims, sizeof(claims), "{\"iat\":%u,\"exp\":%u,\"aud\":\"%s\"}",
            (uint32_t)(m_unix_time), (uint32_t)(timeout), GCP_COAP_IOT_CORE_PROJECT_ID);

    __ASSERT_NO_MSG(length > 0);

    error = jwt_create((uint8_t *)&jwt[offset], &output_len, (const uint8_t *)claims, strlen(claims),
            (const uint8_t *)GCP_COAP_IOT_CORE_DEVICE_KEY, sizeof(GCP_COAP_IOT_CORE_DEVICE_KEY));

    __ASSERT_NO_MSG(error == OT_ERROR_NONE);

    coap_packet_append_option(p_message, COAP_OPTION_PROXY_URI,
            jwt, strlen(jwt));
}


void coap_publish_new(void)
{
    int ret;
    struct coap_packet request;
    uint8_t data[MAX_COAP_MSG_LEN];


    ret = coap_packet_init(&request, data, sizeof(data),
            1, OT_COAP_TYPE_NON_CONFIRMABLE, 2, coap_next_token(),
            COAP_METHOD_POST, coap_next_id());
    if (ret < 0) {
        LOG_ERR("COAP packet init failed: %d", ret);
    }

    ret = coap_packet_append_option(&request, COAP_OPTION_URI_PATH,
            GCP_COAP_IOT_CORE_PATH, strlen(GCP_COAP_IOT_CORE_PATH));
    if (ret < 0) {
        LOG_ERR("COAP append option failed: %d", ret);
    }

    coap_header_proxy_uri_append(&request, GCP_COAP_IOT_CORE_PUBLISH);

    ret = coap_packet_append_payload_marker(&request);
    if (ret < 0) {
        LOG_ERR("COAP append append payload marker failed: %d", ret);
    }

    ret = coap_packet_append_payload(&request, (uint8_t *)coap_buffer, 
            (COAP_BUFF_METADATA_SIZE+(NUM_DIMS*COAP_BUFF_TIMESTEPS))*sizeof(float));
    if (ret < 0) {
        LOG_ERR("COAP append payload failed: %d", ret);
    }

    ret = send(sock, request.data, request.offset, 0);
    if (ret < 0) {
        LOG_ERR("Socket send failed: %d", ret); 
    }
}

static void toggle_minimal_sleepy_end_device(struct k_work *item)
{
	otError error;
	otLinkModeConfig mode;
	struct openthread_context *context = openthread_get_default_context();

	__ASSERT_NO_MSG(context != NULL);

	openthread_api_mutex_lock(context);
	mode = otThreadGetLinkMode(context->instance);
	mode.mRxOnWhenIdle = !mode.mRxOnWhenIdle;
	error = otThreadSetLinkMode(context->instance, mode);
	openthread_api_mutex_unlock(context);

	if (error != OT_ERROR_NONE) {
		LOG_ERR("Failed to set MLE link mode configuration");
	} else {
		LOG_INF("Success set MLE link mode configuration");
		on_mtd_mode_toggle(mode.mRxOnWhenIdle);
	}
}

void coap_client_toggle_minimal_sleepy_end_device(void)
{
	if (IS_ENABLED(CONFIG_OPENTHREAD_MTD_SED)) {
		k_work_submit(&toggle_MTD_SED_work);
	}
}

void coap_close_socket(void)
{
    (void)close(sock);
}

int coap_open_socket(void)
{
    int ret = 0;
    struct sockaddr_in6 addr6;

    addr6.sin6_family = AF_INET6;
    addr6.sin6_port = htons(GCP_COAP_IOT_CORE_SERVER_SECURE_PORT);

    inet_pton(AF_INET6, GCP_COAP_IOT_CORE_SERVER_ADDRESS, &addr6.sin6_addr);

    sock = socket(addr6.sin6_family, SOCK_DGRAM, IPPROTO_DTLS_1_2);
    if (sock < 0) {
        LOG_ERR("Failed to create UDP socket %d", errno);
        return -errno;
    }


    ret = setsockopt(sock, SOL_TLS, TLS_SEC_TAG_LIST,
            sec_tag_list, sizeof(sec_tag_list));
    if (ret < 0) {
        LOG_ERR("Failed to set sockopt: %d", ret);
        return ret;
    }

    //Call connect so we can use send and recv
    ret = connect(sock, (const struct sockaddr *)&addr6, sizeof(addr6));
    if (ret < 0) {
        LOG_ERR("Error coneccting: %d", ret);
        return ret;
    }

    LOG_INF("Connection Successful!");
    return 0;
}

static void update_device_state(void)
{
	struct otInstance *instance = openthread_get_default_instance();
	otLinkModeConfig mode = otThreadGetLinkMode(instance);
	on_mtd_mode_toggle(mode.mRxOnWhenIdle);
}

static void on_thread_state_changed(uint32_t flags, void *context)
{
	struct openthread_context *ot_context = context;

	if (flags & OT_CHANGED_THREAD_ROLE) {
		switch (otThreadGetDeviceRole(ot_context->instance)) {
		case OT_DEVICE_ROLE_CHILD:
            LOG_INF("Child");
		case OT_DEVICE_ROLE_ROUTER:
            LOG_INF("Router");
		case OT_DEVICE_ROLE_LEADER:
            LOG_INF("Leader");
            if (!is_connected){
            is_connected = true;
            k_work_submit(&on_connect_work);
            }
			break;

		case OT_DEVICE_ROLE_DISABLED:
            LOG_INF("Disabled");
		case OT_DEVICE_ROLE_DETACHED:
            LOG_INF("Detached");
		default:
            LOG_INF("Default");
            if (is_connected){
            k_work_submit(&on_disconnect_work);
			is_connected = false;
            }
			break;
		}
	}
}

static void dtls_init(void){

    int ret;
    ret = tls_credential_add(PSK_TAG,
            TLS_CREDENTIAL_PSK,
            psk,
            sizeof(psk) - 1);
    if (ret < 0) {
        LOG_ERR("Failed to add tls credential PSK: %d", ret);
    }

    ret = tls_credential_add(PSK_TAG,
            TLS_CREDENTIAL_PSK_ID,
            psk_id,
            sizeof(psk_id) - 1);
    if (ret < 0) {
        LOG_ERR("Failed to add tls credential PSKID: %d", ret);
    }
    return;
}

void coap_client_utils_init(ot_connection_cb_t on_connect,
			    ot_disconnection_cb_t on_disconnect,
			    mtd_mode_toggle_cb_t on_toggle){

    dtls_init();
	on_mtd_mode_toggle = on_toggle;
    k_work_init(&on_connect_work, on_connect);
    k_work_init(&on_disconnect_work, on_disconnect);
    k_work_init(&toggle_MTD_SED_work,
            toggle_minimal_sleepy_end_device);

	openthread_set_state_changed_cb(on_thread_state_changed);
	openthread_start(openthread_get_default_context());
    update_device_state();
}
```

## src/coap_client_utils.h
```c
#ifndef __COAP_UTILS_H__
#define __COAP_UTILS_H__

#include <zephyr/kernel.h>
#include <sys/_stdint.h>

#define TIMEIT 0 //TIME THE INFERENCE/TRANSMISSION TASK
#define DATA_COLLECTION 0 //SWITCH TO DATA_COLLECT SETUP
#define NUM_DIMS 13 //NUMBER OF IMU DATAPOINTS PER READING
#define COAP_BUFF_METADATA_SIZE 4 //EXTRA BUFFER SPACE FOR METADATA 
#define COAP_BUFF_TIMESTEPS 2 //SIZE OF TRANSMISSION BUFFER
#define DETECT_BUFF_TIMESTEPS 16 // MUST BE A MULTIPLE OF COAP_BUFF_TIMESTEPS
#define DETECTION_PADDING DETECT_BUFF_TIMESTEPS/2
#define IMU_FREQ_MS 250 //FREQ IN MS
#define THRESHOLD .5 //ML PROBABILITY THRESHOLD

/** @brief Type indicates function called when OpenThread connection
 *         is established.
 *
 * @param[in] item pointer to work item.
 */
typedef void (*ot_connection_cb_t)(struct k_work *item);

/** @brief Type indicates function called when OpenThread connection is ended.
 *
 * @param[in] item pointer to work item.
 */
typedef void (*ot_disconnection_cb_t)(struct k_work *item);

/** @brief Type indicates function called when the MTD modes are toggled.
 *
 * @param[in] val 1 if the MTD is in MED mode
 *                0 if the MTD is in SED mode
 */
typedef void (*mtd_mode_toggle_cb_t)(uint32_t val);

extern float coap_buffer[COAP_BUFF_METADATA_SIZE+(NUM_DIMS*COAP_BUFF_TIMESTEPS)];
extern float detection_buffer[NUM_DIMS*DETECT_BUFF_TIMESTEPS];
extern int counter;
extern float output;
extern int session_time;
extern bool is_connected;

/** @brief Initialize CoAP client utilities.
 */
void coap_client_utils_init(ot_connection_cb_t on_connect,
			    ot_disconnection_cb_t on_disconnect,
			    mtd_mode_toggle_cb_t on_toggle);

int coap_open_socket(void);
void coap_close_socket(void);
void coap_publish_new(void);
int set_clock_sntp(void);
void coap_client_toggle_minimal_sleepy_end_device(void);

#endif
```
